## drivers/audio/tad5x12/Kconfig
```kconfig
config AUDIO_CODEC_TAD5X12
	bool "TAD5X12 DAC support"
	default y
	select I2C
	depends on DT_HAS_TI_TAD5X12_ENABLED
	depends on AUDIO_CODEC
	help
	  Enable TAD5X12 support
```

## dts/bindings/audio/ti,tad5x12.yml
```yaml
description: TI TAD5X12 dac

include: [i2c-device.yaml]

compatible: "ti,tad5x12"

properties:
  reg:
    required: true
```
